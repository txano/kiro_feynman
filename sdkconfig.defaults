## sdkconfig.defaults
```kconfig
# ESP32-S3 SDK Configuration
# This file configures ESP-IDF settings for the Arduino framework

# Enable certificate bundle for proper HTTPS support
CONFIG_MBEDTLS_CERTIFICATE_BUNDLE=y
CONFIG_MBEDTLS_CERTIFICATE_BUNDLE_DEFAULT_FULL=y

# TLS/SSL Protocol support
CONFIG_MBEDTLS_SSL_PROTO_TLS1_2=y
CONFIG_MBEDTLS_SSL_PROTO_TLS1_3=n

# CRITICAL: Increase mbedTLS buffer sizes to prevent -0x7780 error
# Default is 16384 (16KB), increase to 18KB for Supabase
CONFIG_MBEDTLS_SSL_IN_CONTENT_LEN=18432
CONFIG_MBEDTLS_SSL_OUT_CONTENT_LEN=4096

# Reduce dynamic memory allocation during handshake
CONFIG_MBEDTLS_DYNAMIC_BUFFER=y
CONFIG_MBEDTLS_DYNAMIC_FREE_PEER_CERT=y
CONFIG_MBEDTLS_DYNAMIC_FREE_CONFIG_DATA=y

# HTTP Client configuration
CONFIG_ESP_HTTP_CLIENT_ENABLE_HTTPS=y

# TEMPORARY: Allow insecure TLS to test download (skip certificate verification)
# TODO: Get proper Supabase/Cloudflare certificate and re-enable verification
CONFIG_ESP_TLS_INSECURE=y
CONFIG_ESP_TLS_SKIP_SERVER_CERT_VERIFY=y

# Logging
CONFIG_LOG_DEFAULT_LEVEL_INFO=y

# Memory optimization
CONFIG_MBEDTLS_ASYMMETRIC_CONTENT_LEN=y
```
